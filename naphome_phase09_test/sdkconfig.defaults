## naphome_phase09_test/sdkconfig.defaults
```kconfig
# Enable ESP32-S3-Korvo-1 board
CONFIG_ESP32_S3_KORVO_1_V4_0_BOARD=y

# Enable WiFi
CONFIG_ESP32_WIFI_STATIC_RX_BUFFER_NUM=10
CONFIG_ESP32_WIFI_DYNAMIC_RX_BUFFER_NUM=32

# Enable HTTP client for Google TTS
CONFIG_ESP_HTTP_CLIENT_ENABLE_HTTPS=y

# Enable mbedTLS for HTTPS
CONFIG_MBEDTLS_CERTIFICATE_BUNDLE=y
CONFIG_MBEDTLS_CERTIFICATE_BUNDLE_DEFAULT_FULL=y

# Audio configuration
CONFIG_ESP32_I2S_AUDIO_ENABLED=y
```

## naphome_phase09_test/sdkconfig.defaults.esp32s3
```kconfig
# ESP32-S3 Configuration for Naphome Phase 0.9 Test Suite
CONFIG_IDF_TARGET="esp32s3"
CONFIG_ESPTOOLPY_FLASHMODE_QIO=y
CONFIG_ESPTOOLPY_FLASHSIZE_16MB=y
CONFIG_PARTITION_TABLE_CUSTOM=y

# Enable ESP32-S3-Korvo-1 board
CONFIG_ESP32_S3_KORVO_1_V4_0_BOARD=y

# ESP-SR Configuration
CONFIG_SR_VADN_VADNET1_MEDIUM=y
CONFIG_SR_WN_WN9_HIESP=y
CONFIG_SR_MN_EN_MULTINET5_SINGLE_RECOGNITION_QUANT8=y

# Enable WiFi
CONFIG_ESP_WIFI_STATIC_RX_BUFFER_NUM=10
CONFIG_ESP_WIFI_DYNAMIC_RX_BUFFER_NUM=32
CONFIG_ESP_WIFI_ENABLE_WPA3_SAE=y
CONFIG_ESP_WIFI_SOFTAP_BEACON_MAX_LEN=752
CONFIG_ESP_WIFI_MGMT_SBUF_NUM=32
CONFIG_ESP_WIFI_IRAM_OPT=y
CONFIG_ESP_WIFI_RX_IRAM_OPT=y
CONFIG_ESP_WIFI_ENABLE_WIFI_RX_STATS=y
CONFIG_ESP_WIFI_ENABLE_WIFI_TX_STATS=y

# Enable HTTP client for Google TTS
CONFIG_ESP_HTTP_CLIENT_ENABLE_HTTPS=y

# Enable mbedTLS for HTTPS
CONFIG_MBEDTLS_CERTIFICATE_BUNDLE=y
CONFIG_MBEDTLS_CERTIFICATE_BUNDLE_DEFAULT_FULL=y

# PSRAM configuration
CONFIG_SPIRAM=y
CONFIG_SPIRAM_MODE_OCT=y
CONFIG_SPIRAM_SPEED_80M=y

# CPU frequency
CONFIG_ESP_DEFAULT_CPU_FREQ_MHZ_240=y

# Cache configuration
CONFIG_ESP32S3_INSTRUCTION_CACHE_32KB=y
CONFIG_ESP32S3_DATA_CACHE_64KB=y
CONFIG_ESP32S3_DATA_CACHE_LINE_64B=y

# Increase main task stack size to prevent stack overflow during ESP-SR initialization
CONFIG_ESP_MAIN_TASK_STACK_SIZE=8192

# Speech commands (required for ESP-SR to work)
# Copying exact commands from working example to match get_id_name_en expectations
# Phase 0.9 feature commands will be handled via command string matching in detect_Task
# Add English speech commands
#
CONFIG_EN_SPEECH_COMMAND_ID0="TfL Mm c qbK"
CONFIG_EN_SPEECH_COMMAND_ID1="Sgl c Sel"
CONFIG_EN_SPEECH_COMMAND_ID2="PLd NoZ paNcL"
CONFIG_EN_SPEECH_COMMAND_ID3="TkN nN Mi StNDBnKS"
CONFIG_EN_SPEECH_COMMAND_ID4="TkN eF Mi StNDBnKS"
CONFIG_EN_SPEECH_COMMAND_ID5="hicST VnLYoM"
CONFIG_EN_SPEECH_COMMAND_ID6="LbcST VnLYoM"
CONFIG_EN_SPEECH_COMMAND_ID7="gNKRmS jc VnLYoM"
CONFIG_EN_SPEECH_COMMAND_ID8="DgKRmS jc VnLYoM"
CONFIG_EN_SPEECH_COMMAND_ID9="TkN nN jc TmVm"
CONFIG_EN_SPEECH_COMMAND_ID10="TkN eF jc TmVm"
CONFIG_EN_SPEECH_COMMAND_ID11="MdK Mm c Tm"
CONFIG_EN_SPEECH_COMMAND_ID12="MdK Mm c KnFm"
CONFIG_EN_SPEECH_COMMAND_ID13="TkN nN jc LiT"
CONFIG_EN_SPEECH_COMMAND_ID14="TkN eF jc LiT"
CONFIG_EN_SPEECH_COMMAND_ID15="pdNq jc KcLk To RfD"
CONFIG_EN_SPEECH_COMMAND_ID16="pdNq jc KcLk To GRmN"
CONFIG_EN_SPEECH_COMMAND_ID17="TkN nN eL jc LiTS"
CONFIG_EN_SPEECH_COMMAND_ID18="TkN eF eL jc LiTS"
CONFIG_EN_SPEECH_COMMAND_ID19="TkN nN jc fR KcNDgscNk"
CONFIG_EN_SPEECH_COMMAND_ID20="TkN eF jc fR KcNDgscNk"
CONFIG_EN_SPEECH_COMMAND_ID21="SfT jc TfMPRcpk To SgKSTmN DgGRmZ"
CONFIG_EN_SPEECH_COMMAND_ID22="SfT jc TfMPRcpk To SfVcNTmN DgGRmZ"
CONFIG_EN_SPEECH_COMMAND_ID23="SfT jc TfMPRcpk To dTmN DgGRmZ"
CONFIG_EN_SPEECH_COMMAND_ID24="SfT jc TfMPRcpk To NiNTmN DgGRmZ"
CONFIG_EN_SPEECH_COMMAND_ID25="SfT jc TfMPRcpk To TWfNTm DgGRmZ"
CONFIG_EN_SPEECH_COMMAND_ID26="SfT jc TfMPRcpk To TWfNTm WcN DgGRmZ"
CONFIG_EN_SPEECH_COMMAND_ID27="SfT jc TfMPRcpk To TWfNTm To DgGRmZ"
CONFIG_EN_SPEECH_COMMAND_ID28="SfT jc TfMPRcpk To TWfNTm vRm DgGRmZ"
CONFIG_EN_SPEECH_COMMAND_ID29="SfT jc TfMPRcpk To TWfNTm FeR DgGRmZ"
CONFIG_EN_SPEECH_COMMAND_ID30="SfT jc TfMPRcpk To TWfNTm FiV DgGRmZ"
CONFIG_EN_SPEECH_COMMAND_ID31="SfT jc TfMPRcpk To TWfNTm SgKS DgGRmZ"
CONFIG_EN_SPEECH_COMMAND_ID32=""
CONFIG_EN_SPEECH_COMMAND_ID33=""
CONFIG_EN_SPEECH_COMMAND_ID34=""
CONFIG_EN_SPEECH_COMMAND_ID35=""
CONFIG_EN_SPEECH_COMMAND_ID36=""
CONFIG_EN_SPEECH_COMMAND_ID37=""
CONFIG_EN_SPEECH_COMMAND_ID38=""
CONFIG_EN_SPEECH_COMMAND_ID39=""
CONFIG_EN_SPEECH_COMMAND_ID40=""
CONFIG_EN_SPEECH_COMMAND_ID41=""
CONFIG_EN_SPEECH_COMMAND_ID42=""
CONFIG_EN_SPEECH_COMMAND_ID43=""
CONFIG_EN_SPEECH_COMMAND_ID44=""
CONFIG_EN_SPEECH_COMMAND_ID45=""
CONFIG_EN_SPEECH_COMMAND_ID46=""
CONFIG_EN_SPEECH_COMMAND_ID47=""
CONFIG_EN_SPEECH_COMMAND_ID48=""
CONFIG_EN_SPEECH_COMMAND_ID49=""
CONFIG_EN_SPEECH_COMMAND_ID50=""
CONFIG_EN_SPEECH_COMMAND_ID51=""
CONFIG_EN_SPEECH_COMMAND_ID52=""
CONFIG_EN_SPEECH_COMMAND_ID53=""
CONFIG_EN_SPEECH_COMMAND_ID54=""
CONFIG_EN_SPEECH_COMMAND_ID55=""
CONFIG_EN_SPEECH_COMMAND_ID56=""
CONFIG_EN_SPEECH_COMMAND_ID57=""
CONFIG_EN_SPEECH_COMMAND_ID58=""
CONFIG_EN_SPEECH_COMMAND_ID59=""
CONFIG_EN_SPEECH_COMMAND_ID60=""
CONFIG_EN_SPEECH_COMMAND_ID61=""
CONFIG_EN_SPEECH_COMMAND_ID62=""
CONFIG_EN_SPEECH_COMMAND_ID63=""
CONFIG_EN_SPEECH_COMMAND_ID64=""
CONFIG_EN_SPEECH_COMMAND_ID65=""
CONFIG_EN_SPEECH_COMMAND_ID66=""
CONFIG_EN_SPEECH_COMMAND_ID67=""
CONFIG_EN_SPEECH_COMMAND_ID68=""
CONFIG_EN_SPEECH_COMMAND_ID69=""
CONFIG_EN_SPEECH_COMMAND_ID70=""
CONFIG_EN_SPEECH_COMMAND_ID71=""
CONFIG_EN_SPEECH_COMMAND_ID72=""
CONFIG_EN_SPEECH_COMMAND_ID73=""
CONFIG_EN_SPEECH_COMMAND_ID74=""
CONFIG_EN_SPEECH_COMMAND_ID75=""
CONFIG_EN_SPEECH_COMMAND_ID76=""
CONFIG_EN_SPEECH_COMMAND_ID77=""
CONFIG_EN_SPEECH_COMMAND_ID78=""
CONFIG_EN_SPEECH_COMMAND_ID79=""
CONFIG_EN_SPEECH_COMMAND_ID80=""
CONFIG_EN_SPEECH_COMMAND_ID81=""
CONFIG_EN_SPEECH_COMMAND_ID82=""
CONFIG_EN_SPEECH_COMMAND_ID83=""
CONFIG_EN_SPEECH_COMMAND_ID84=""
CONFIG_EN_SPEECH_COMMAND_ID85=""
CONFIG_EN_SPEECH_COMMAND_ID86=""
CONFIG_EN_SPEECH_COMMAND_ID87=""
CONFIG_EN_SPEECH_COMMAND_ID88=""
CONFIG_EN_SPEECH_COMMAND_ID89=""
CONFIG_EN_SPEECH_COMMAND_ID90=""
CONFIG_EN_SPEECH_COMMAND_ID91=""
CONFIG_EN_SPEECH_COMMAND_ID92=""
CONFIG_EN_SPEECH_COMMAND_ID93=""
CONFIG_EN_SPEECH_COMMAND_ID94=""
CONFIG_EN_SPEECH_COMMAND_ID95=""
CONFIG_EN_SPEECH_COMMAND_ID96=""
CONFIG_EN_SPEECH_COMMAND_ID97=""
CONFIG_EN_SPEECH_COMMAND_ID98=""
CONFIG_EN_SPEECH_COMMAND_ID99=""
CONFIG_EN_SPEECH_COMMAND_ID100=""
CONFIG_EN_SPEECH_COMMAND_ID101=""
CONFIG_EN_SPEECH_COMMAND_ID102=""
CONFIG_EN_SPEECH_COMMAND_ID103=""
CONFIG_EN_SPEECH_COMMAND_ID104=""
CONFIG_EN_SPEECH_COMMAND_ID105=""
CONFIG_EN_SPEECH_COMMAND_ID106=""
CONFIG_EN_SPEECH_COMMAND_ID107=""
CONFIG_EN_SPEECH_COMMAND_ID108=""
CONFIG_EN_SPEECH_COMMAND_ID109=""
CONFIG_EN_SPEECH_COMMAND_ID110=""
CONFIG_EN_SPEECH_COMMAND_ID111=""
CONFIG_EN_SPEECH_COMMAND_ID112=""
CONFIG_EN_SPEECH_COMMAND_ID113=""
CONFIG_EN_SPEECH_COMMAND_ID114=""
CONFIG_EN_SPEECH_COMMAND_ID115=""
CONFIG_EN_SPEECH_COMMAND_ID116=""
CONFIG_EN_SPEECH_COMMAND_ID117=""
CONFIG_EN_SPEECH_COMMAND_ID118=""
CONFIG_EN_SPEECH_COMMAND_ID119=""
CONFIG_EN_SPEECH_COMMAND_ID120=""
CONFIG_EN_SPEECH_COMMAND_ID121=""
CONFIG_EN_SPEECH_COMMAND_ID122=""
CONFIG_EN_SPEECH_COMMAND_ID123=""
CONFIG_EN_SPEECH_COMMAND_ID124=""
CONFIG_EN_SPEECH_COMMAND_ID125=""
CONFIG_EN_SPEECH_COMMAND_ID126=""
CONFIG_EN_SPEECH_COMMAND_ID127=""
CONFIG_EN_SPEECH_COMMAND_ID128=""
CONFIG_EN_SPEECH_COMMAND_ID129=""
CONFIG_EN_SPEECH_COMMAND_ID130=""
CONFIG_EN_SPEECH_COMMAND_ID131=""
CONFIG_EN_SPEECH_COMMAND_ID132=""
CONFIG_EN_SPEECH_COMMAND_ID133=""
CONFIG_EN_SPEECH_COMMAND_ID134=""
CONFIG_EN_SPEECH_COMMAND_ID135=""
CONFIG_EN_SPEECH_COMMAND_ID136=""
CONFIG_EN_SPEECH_COMMAND_ID137=""
CONFIG_EN_SPEECH_COMMAND_ID138=""
CONFIG_EN_SPEECH_COMMAND_ID139=""
CONFIG_EN_SPEECH_COMMAND_ID140=""
CONFIG_EN_SPEECH_COMMAND_ID141=""
CONFIG_EN_SPEECH_COMMAND_ID142=""
CONFIG_EN_SPEECH_COMMAND_ID143=""
CONFIG_EN_SPEECH_COMMAND_ID144=""
CONFIG_EN_SPEECH_COMMAND_ID145=""
CONFIG_EN_SPEECH_COMMAND_ID146=""
CONFIG_EN_SPEECH_COMMAND_ID147=""
CONFIG_EN_SPEECH_COMMAND_ID148=""
CONFIG_EN_SPEECH_COMMAND_ID149=""
CONFIG_EN_SPEECH_COMMAND_ID150=""
CONFIG_EN_SPEECH_COMMAND_ID151=""
CONFIG_EN_SPEECH_COMMAND_ID152=""
CONFIG_EN_SPEECH_COMMAND_ID153=""
CONFIG_EN_SPEECH_COMMAND_ID154=""
CONFIG_EN_SPEECH_COMMAND_ID155=""
CONFIG_EN_SPEECH_COMMAND_ID156=""
CONFIG_EN_SPEECH_COMMAND_ID157=""
CONFIG_EN_SPEECH_COMMAND_ID158=""
CONFIG_EN_SPEECH_COMMAND_ID159=""
CONFIG_EN_SPEECH_COMMAND_ID160=""
CONFIG_EN_SPEECH_COMMAND_ID161=""
CONFIG_EN_SPEECH_COMMAND_ID162=""
CONFIG_EN_SPEECH_COMMAND_ID163=""
CONFIG_EN_SPEECH_COMMAND_ID164=""
CONFIG_EN_SPEECH_COMMAND_ID165=""
CONFIG_EN_SPEECH_COMMAND_ID166=""
CONFIG_EN_SPEECH_COMMAND_ID167=""
CONFIG_EN_SPEECH_COMMAND_ID168=""
CONFIG_EN_SPEECH_COMMAND_ID169=""
CONFIG_EN_SPEECH_COMMAND_ID170=""
CONFIG_EN_SPEECH_COMMAND_ID171=""
CONFIG_EN_SPEECH_COMMAND_ID172=""
CONFIG_EN_SPEECH_COMMAND_ID173=""
CONFIG_EN_SPEECH_COMMAND_ID174=""
CONFIG_EN_SPEECH_COMMAND_ID175=""
CONFIG_EN_SPEECH_COMMAND_ID176=""
CONFIG_EN_SPEECH_COMMAND_ID177=""
CONFIG_EN_SPEECH_COMMAND_ID178=""
CONFIG_EN_SPEECH_COMMAND_ID179=""
CONFIG_EN_SPEECH_COMMAND_ID180=""
CONFIG_EN_SPEECH_COMMAND_ID181=""
CONFIG_EN_SPEECH_COMMAND_ID182=""
CONFIG_EN_SPEECH_COMMAND_ID183=""
CONFIG_EN_SPEECH_COMMAND_ID184=""
CONFIG_EN_SPEECH_COMMAND_ID185=""
CONFIG_EN_SPEECH_COMMAND_ID186=""
CONFIG_EN_SPEECH_COMMAND_ID187=""
CONFIG_EN_SPEECH_COMMAND_ID188=""
CONFIG_EN_SPEECH_COMMAND_ID189=""
CONFIG_EN_SPEECH_COMMAND_ID190=""
CONFIG_EN_SPEECH_COMMAND_ID191=""
CONFIG_EN_SPEECH_COMMAND_ID192=""
CONFIG_EN_SPEECH_COMMAND_ID193=""
CONFIG_EN_SPEECH_COMMAND_ID194=""
CONFIG_EN_SPEECH_COMMAND_ID195=""
CONFIG_EN_SPEECH_COMMAND_ID196=""
CONFIG_EN_SPEECH_COMMAND_ID197=""
CONFIG_EN_SPEECH_COMMAND_ID198=""
CONFIG_EN_SPEECH_COMMAND_ID199=""
```
